## max30102/zephyr/dts/bindings/maxim,max30102-i2c.yaml
```yaml
# SPDX-License-Identifier: Apache-2.0

description: Maxim MAX30102 sensor
compatible: "maxim,max30102"
include: [sensor-device.yaml, i2c-device.yaml]
```

## stc31/zephyr/Kconfig
```kconfig
# STC31 CO2 sensor

# SPDX-License-Identifier: Apache-2.0

menuconfig STC31
    bool "STC31 CO2 Sensor"
    default y
    depends on DT_HAS_SENSIRION_STC31_ENABLED
    select I2C

if STC31

endif # STC31
```

## stc31/zephyr/dts/bindings/sensirion,stc31-i2c.yaml
```yaml
# SPDX-License-Identifier: Apache-2.0

description: Sensirion ssd1306 sensor
compatible: "sensirion,stc31"
include: [sensor-device.yaml, i2c-device.yaml]
```
